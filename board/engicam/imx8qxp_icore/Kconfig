## board/engicam/imx8qxp_icore/Kconfig
```kconfig
if TARGET_IMX8QXP_ICORE

config SYS_BOARD
	default "imx8qxp_icore"

config SYS_VENDOR
	default "engicam"

config SYS_CONFIG_NAME
	default "imx8qxp_icore"

config IMX_CONFIG
	default "board/engicam/imx8qxp_icore/imximage.cfg"

endif
```

## board/engicam/imx93_microgea/Kconfig
```kconfig
if TARGET_IMX93_MICROGEA

config SYS_BOARD
	default "imx93_microgea"

config SYS_VENDOR
	default "engicam"

config SYS_CONFIG_NAME
	default "imx93_microgea"

config IMX93_MICROGEA
	bool "Using LPDDR4X Timing and PMIC voltage"
	default y
	select IMX9_DRAM
	select IMX9_LPDDR4X

config IMX93_MICROGEA_1GB
	bool "Using LPDDR4X Timing for 1GB RAM and PMIC voltage"
	default n
	select IMX9_DRAM
	select IMX9_LPDDR4X_1GB

endif
```

## board/engicam/imx95_icore/Kconfig
```kconfig
if TARGET_IMX95_ICORE

config SYS_BOARD
	default "imx95_icore"

config SYS_VENDOR
	default "engicam"

config SYS_CONFIG_NAME
	default "imx95_icore"

endif
```

## board/engicam/imx95_smarcore/Kconfig
```kconfig
if TARGET_IMX95_SMARCORE

config SYS_BOARD
	default "imx95_smarcore"

config SYS_VENDOR
	default "engicam"

config SYS_CONFIG_NAME
	default "imx95_smarcore"

endif
```
